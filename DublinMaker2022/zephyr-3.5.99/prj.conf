## CMakeLists.txt
```
# SPDX-License-Identifier: Apache-2.0

cmake_minimum_required(VERSION 3.13.1)

find_package(Zephyr REQUIRED HINTS $ENV{ZEPHYR_BASE})
project(hello_world)

target_sources(app PRIVATE src/main.cpp src/display.cpp src/controller.cpp src/console.cpp src/sound.cpp src/invaders.cpp src/sprite.cpp src/brick.cpp src/brici.cpp src/mesh.c src/battleship.cpp src/messaging.cpp src/frame_buffer.cpp src/menu.cpp src/osk.cpp src/realm.cpp  )
```

## prj.conf
```kconfig
CONFIG_SYSTEM_WORKQUEUE_STACK_SIZE=4096
CONFIG_MAIN_STACK_SIZE=4096


CONFIG_BT=y
CONFIG_BT_DEBUG_LOG=y
# Security manager protocol support for pairing
CONFIG_BT_SMP=y
# used to sign authenticated data
CONFIG_BT_SIGNING=y
# select peripheral role
CONFIG_BT_PERIPHERAL=n

# enable GATT device information service
CONFIG_BT_DIS=n
# number of buffers available for GATT writing
CONFIG_BT_ATT_PREPARE_COUNT=5

# enables local privacy feature support (Random MAC)
CONFIG_BT_PRIVACY=n
# name that appears when browsing
CONFIG_BT_DEVICE_NAME="DublinMaker1"

CONFIG_BT_DEVICE_APPEARANCE=1216
# disable updating of device name to prevent use of generic name
# disable run-time changing of device name
CONFIG_BT_DEVICE_NAME_DYNAMIC=n
CONFIG_BT_OBSERVER=y
CONFIG_BT_KEYS_OVERWRITE_OLDEST=y

#CONFIG_BT_RX_STACK_SIZE=1280 # This causes system to crash/stop working.
CONFIG_BT_CTLR_DUP_FILTER_LEN=0
CONFIG_BT_BROADCASTER=y
CONFIG_BT_PHY_UPDATE=n
CONFIG_BT_DATA_LEN_UPDATE=n
CONFIG_BT_MESH_CFG_CLI=y

# enable SPI and GPIO
CONFIG_SPI=y
CONFIG_SPI_NRFX=y
CONFIG_GPIO=y
CONFIG_PWM=y
# By default P0.10 and P0.9 are configured for NFC and so not available for GPIO/UART use.  
# This switches them back to GPIO
CONFIG_NFCT_PINS_AS_GPIOS=y
# This doesn't seem to be working
CONFIG_GPIO_AS_PINRESET=n

# enable uart driver
CONFIG_SERIAL=y

# enable console
CONFIG_CONSOLE=y
CONFIG_UART_CONSOLE=y
# Turn on internal RC clock
CONFIG_CLOCK_CONTROL_NRF_K32SRC_RC=y
CONFIG_I2C=y

CONFIG_PM=n
CONFIG_HEAP_MEM_POOL_SIZE=8192
#need to turn these off for microbit v2 as they prevent low level fiddling with the i2c devices
CONFIG_LIS2DH=n
CONFIG_LIS2MDL=n
CONFIG_SYSTEM_WORKQUEUE_STACK_SIZE=2048

CONFIG_BT_SETTINGS=n
CONFIG_FLASH=y
CONFIG_FLASH_MAP=y
CONFIG_NVS=y
CONFIG_SETTINGS=y
CONFIG_HWINFO=y

CONFIG_BT_L2CAP_TX_BUF_COUNT=15
CONFIG_BT_PERIPHERAL=y
CONFIG_BT_CTLR_LE_ENC=n
CONFIG_BT_CTLR_LE_PING=n
CONFIG_BT_CTLR_MIN_USED_CHAN=n
CONFIG_BT_CTLR_PRIVACY=n
CONFIG_BT_CTLR_CHAN_SEL_2=n

CONFIG_BT_MESH=y
CONFIG_BT_MESH_MODEL_EXTENSIONS=y
#CONFIG_BT_MESH_RELAY=y
CONFIG_BT_MESH_FRIEND=y
CONFIG_BT_MESH_PB_GATT=y
CONFIG_BT_MESH_PB_ADV=y
CONFIG_BT_MESH_GATT_PROXY=y
CONFIG_BT_MESH_MODEL_KEY_COUNT=10
CONFIG_BT_MESH_SUBNET_COUNT=2
CONFIG_BT_MESH_APP_KEY_COUNT=2
CONFIG_BT_MESH_MODEL_GROUP_COUNT=2
CONFIG_BT_MESH_LABEL_COUNT=3
CONFIG_BT_MESH_ADV_BUF_COUNT=15
#CONFIG_BT_MESH_NETWORK_TRANSMIT_COUNT=1
#CONFIG_BT_MESH_NETWORK_TRANSMIT_INTERVAL=10
```

## src/main.cpp
```c
#include <zephyr/kernel.h>
#include <zephyr/sys/printk.h>

#include <zephyr/settings/settings.h>

#include <zephyr/bluetooth/bluetooth.h>
#include <zephyr/bluetooth/mesh.h>
#include <zephyr/bluetooth/hci.h>
#include <zephyr/bluetooth/conn.h>
#include <zephyr/bluetooth/uuid.h>
#include <zephyr/bluetooth/gatt.h>
#include <zephyr/drivers/pwm.h>
#include <zephyr/drivers/flash.h>
#include <zephyr/storage/flash_map.h>
#include <zephyr/fs/nvs.h>
//#include <stdlib.h>
#include "display.h"
#include "controller.h"
#include "console.h"
#include "sound.h"
#include "invaders.h"
#include "brici.h"
//#include "mesh.h"
#include "battleship.h"
#include "messaging.h"
#include "frame_buffer.h"
#include "menu.h"
#include "osk.h"
#include "dmb_message_type.h"
#include "realm.h"
#include "logo_bricks.h"
extern "C" {
#include "mesh.h"
}
extern console Console;
extern volatile uint32_t DMBMessageReceived;
extern volatile dmb_message DMBMailBox;
extern volatile uint16_t DMBMessageSender;
extern volatile uint32_t DMBGameMessageReceived;
extern volatile dmb_message DMBGameMailBox; 




int doMainMenu()
{
	const char c1[] = "Galaga";
	const char c2[] = "Brici";
	const char c3[] = "Battleship";
	const char c4[] = "Microrealms";
	const char c5[] = "Messaging";
	const char c6[] = "Settings";
	const char c7[] = "About";
	const char c8[] = "Mesh Start"; // Add new option here
    const char c9[] = "Mesh End";

	const char *choices[] = {c1, c2, c3, c4, c5, c6, c7, c8, c9}; // Include new option
	menu Menu(&Console.Display, &Console.Controller, choices, sizeof(choices) / sizeof(const char *));
	Menu.show();
	return Menu.getChoice(2000);
}

char Name[MAX_NAME_LEN];
uint16_t Address;

int load_settings(void);
int change_settings(void);
void drawLogo(uint32_t demo_mode);
void about(void);
int main(void)
{

	int ret;
	int count=0;		
	ret = Console.begin();		
    	load_settings();
	if (ret < 0)
	{
		printk("\nError initializing console.  Error code = %d\n",ret);
		while(1);
	}
	
	uint16_t tones[]={A3,A5,E4,G4,A5};
	uint16_t times[]={150,150,150,150,250};
    Console.Sound.playMelody(tones, times,5);
	k_msleep(50);
	drawLogo(3);
	while(Console.Controller.getButtonState()==0);
    while(1) 
	{
		Console.Display.clear();
		ret = doMainMenu();
		printk("Choice=%d\r\n",ret);
		if (ret==0)
		{
			playInvaders(0);
		}
		if (ret == 1)
		{
			ClassicBrici();
		}
		if (ret == 2)
		{
			// Settings
			battleship();
		}
		if (ret == 3)
		{
			// Settings
			microrealms();
		}
		if (ret ==4 )
		{
			messaging();
		}
		if (ret == 5)
		{
			change_settings();
		}
		if (ret == 6)
		{
			about();
		}
		if (ret == 7)
		{
            mesh_begin(1);

		}
        if (ret == 8)
        {
            mesh_suspend();
        }

		if (ret < 0) // timeout
			drawLogo(3);

	}
	playInvaders(1);
 	
	while(1)
	{
		//printk("Hello World! %s\n", CONFIG_BOARD);
       //Display.drawRectangle(random(0,119),random(0,119),random(0,120),random(0,120),random(0,0xffff));                                
       //Console.Display.fillRectangle(Console.random(0,240),Console.random(0,240),Console.random(0,240),Console.random(0,240),Console.random(0,0xffff));                   
		Console.Display.fillRectangle(0,0,SCREEN_WIDTH,SCREEN_HEIGHT,Console.random(0,0xffff));                   
		///Console.Display.fillRectangle(0,0,SCREEN_WIDTH,SCREEN_HEIGHT,0b1111111111111111);
		///k_msleep(100);
		//Console.Display.fillRectangle(0,0,SCREEN_WIDTH,SCREEN_HEIGHT,0b1111111111011111);                   
		//k_msleep(100);
       // display_drawCircle(random(0,240),random(0,240),random(0,135),random(0,0xffff));
        //Display.fillCircle(random(0,240),random(0,135),random(0,120),random(0,0xffff));

        count++;
        if (count >= 10) 
        {
      //      Console.Display.fillRectangle(0,0,SCREEN_WIDTH,SCREEN_HEIGHT,0);
			
		//	Console.Display.print("Starting over",sizeof("Starting over")-1,20,60,0xffff,0);
            count = 0;
		//	sendDMBMessage(msg_count++);

			//printk("restarting\n");
			if (Console.Controller.getButtonState())
			Console.Sound.playTone(1000,100);
			printk("Buttons = %x\n",Console.Controller.getButtonState());
			
 		//	printk("Buttons = %d\r\n",Console.Controller.getButtonState());
        }        
	}
	return 0;
}
static struct nvs_fs fs;
const struct device *flash_dev;

#define STORAGE_NODE DT_NODE_BY_FIXED_PARTITION_LABEL(storage)
#define FLASH_NODE DT_MTD_FROM_FIXED_PARTITION(STORAGE_NODE)
#define NAME_ID 1
#define ADDRESS_ID 2
int load_settings()
{
    int ret;
    struct flash_pages_info info;
    flash_dev = DEVICE_DT_GET(FLASH_NODE);
    if (!device_is_ready(flash_dev)) {
            printk("Flash device %s is not ready\n", flash_dev->name);
            return -1;
    }
    fs.flash_device=flash_dev;
    fs.offset = FLASH_AREA_OFFSET(storage);
    ret = flash_get_page_info_by_offs(flash_dev, fs.offset, &info);
    if (ret) {
            printk("Unable to get page info\n");
            return -2;
    }
    fs.sector_size = info.size;
    fs.sector_count = 2U;

    ret = nvs_mount(&fs); //nvs_init(&fs, flash_dev->name);
    if (ret) 
    {
        printk("Flash Init failed\n");
        return -3;
    }
    else
    {
        printk("Flash init success\n");
    }
    ret = nvs_read(&fs,NAME_ID,&Name,sizeof(Name));
    if (ret < 0)
    {
        Name[0]='D';
        Name[1]='U';
        Name[2]='B';
        Name[3]=0;
    }
    ret = nvs_read(&fs,ADDRESS_ID,&Address,sizeof(Address));
    if (ret < 0)
    {
        Address=1;
    }
    return 0;
    
}

int change_settings()
{
    int rc = 0;
	osk OSK;
	
    struct flash_pages_info info;

    flash_dev = DEVICE_DT_GET(FLASH_NODE);
    if (!device_is_ready(flash_dev)) {
            printk("Flash device %s is not ready\n", flash_dev->name);
            return -1;
    }
    fs.offset = FLASH_AREA_OFFSET(storage);
    rc = flash_get_page_info_by_offs(flash_dev, fs.offset, &info);
    if (rc) {
            printk("Unable to get page info\n");
            return -2;
    }
    fs.flash_device=flash_dev;
    fs.sector_size = info.size;
    fs.sector_count = 2U;

    rc = nvs_mount(&fs);//nvs_init(&fs, flash_dev->name);
    if (rc) 
    {
        printk("Flash Init failed\n");
        return -3;
    }
    else
    {
        printk("Flash init success\n");
    }
    rc = nvs_read(&fs,NAME_ID,&Name,sizeof(Name));
    Console.Display.clear();
    Console.Display.printX2("Badge name",10,0,0,Console.Display.RGBToWord(0xff,0xff,0), Console.Display.RGBToWord(0,0,0) );
    Console.Display.printX2(Name,Console.Display.mystrlen(Name),0,1+FONT_HEIGHT*2, Console.Display.RGBToWord(0xff,0xff,0), Console.Display.RGBToWord(0,0,0) );
    OSK.show(&Console.Display, &Console.Controller);
    if (OSK.getUserInput(Name)>0)
    {
        rc=nvs_write(&fs,NAME_ID,&Name,sizeof(Name));
    }
    Console.Display.clear();
    Console.Display.printX2("Badge name",10,0,0,Console.Display.RGBToWord(0xff,0xff,0), Console.Display.RGBToWord(0,0,0) );
    Console.Display.printX2(Name,Console.Display.mystrlen(Name),0,1+FONT_HEIGHT*2, Console.Display.RGBToWord(0xff,0xff,0), Console.Display.RGBToWord(0,0,0) );
    while(Console.Controller.getButtonState()); // wait for key release
    Console.Display.clear();
    int Done=0;
    Console.Display.printX2("Badge address",13,0,0,Console.Display.RGBToWord(0xff,0xff,0), Console.Display.RGBToWord(0,0,0) );
    while(!Done)
    {
        Console.Display.printX2(Address,0,1+FONT_HEIGHT*2, Console.Display.RGBToWord(0xff,0xff,0), Console.Display.RGBToWord(0,0,0) );
        uint16_t key=0;
        while(key == 0)
        {
            key=Console.Controller.getButtonState();
            k_msleep(50);
        }
        switch(key)
        {
            case Console.Controller.Up :
            {
                Address++;
                break;
            }
            case Console.Controller.Down :
            {
                Address--;
                break;
            }
            case Console.Controller.A :
            {
                Done=1;
                break;
            }
            case Console.Controller.B :
            {
                Done=2;
                break;
            }
        }
        k_msleep(50);
        if (Done == 1)
        {
            // new address entered
            rc=nvs_write(&fs,ADDRESS_ID,&Address,sizeof(Address));
        }
    }
    return 0;
}
void drawLogo(uint32_t demo_mode)
{
    brick Logo[LOGO_BRICK_COUNT];
    int Count;
    volatile int BrickDataIndex = 0;    
    uint16_t x,y,w,h;
    uint16_t r,g,b;
    uint16_t Colour;
    uint16_t Brick_Count = LOGO_BRICK_COUNT;
 // The logo is defined in the header file  logo_bricks.h
// The colours are defined in this file using just 2 bits for each colour component (r,g,b): total 6 bits of colour
// The following loop defines all of the bricks in memory and "expands" their colour definition to the 16 bits required by the display
    Console.Display.fillRectangle(0,0,SCREEN_WIDTH,SCREEN_HEIGHT,0);
    for (Count = 0; Count < LOGO_BRICK_COUNT; Count++)
    {        
        x = brickattribs[BrickDataIndex];
        y = brickattribs[BrickDataIndex + 1];
        w = brickattribs[BrickDataIndex + 2];
        h = brickattribs[BrickDataIndex + 3];
        Colour = brickattribs[BrickDataIndex + 4];
        r = (Colour & 0x30) >> 4;
        switch (r) {
            case 0: r=0;break;
            case 1: r=63;break;
            case 2: r=127;break;
            case 3: r=255;break;
        }
        g = (Colour & 0x0c) >> 2;
        switch (g) {
            case 0: g=0;break;
            case 1: g=63;break;
            case 2: g=127;break;
            case 3: g=255;break;
        }
        b = (Colour & 0x03);
        switch (b) {
            case 0: b=0;break;
            case 1: b=63;break;
            case 2: b=127;break;
            case 3: b=255;break;
        }
        Colour = COLOUR(r,g,b); // convert the 3 x 8 bit values to a single 16 bit value        
        Logo[Count].define(x,y,w,h,Colour);                           
        BrickDataIndex += 5;
        
    }   
    if (demo_mode == 0)
    {
        for (Count = 0; Count < LOGO_BRICK_COUNT; Count++)
        {
            Logo[Count].show();        
        }

    }
    if (demo_mode==1)
    {
        for (Count = 0; Count < LOGO_BRICK_COUNT; Count++)
        {
            Logo[Count].show();        
        }
        Brici(Logo,Brick_Count,SCREEN_WIDTH,1);
    }
    if (demo_mode==2)
    {
        sprite Invader = { DefaultInvaderImage, 3, 3, 10, 12};
        sprite AttackerMissile = { AttackerMissileImage, 0, 0, 5, 8  };
        Invader.show();
        Invader.move(Invader.getX()+Console.random(0,200),Invader.getY());
        int XDirectionChange = 0;
        int YDirectionChange = 0;
        int x_step = 2;
        int y_step = 1;
        for (Count = 0; Count < LOGO_BRICK_COUNT; Count++)
        {
            Logo[Count].move(Logo[Count].getX(),Logo[Count].getY()+120);
            Logo[Count].show();                    
        }
       
        for (Count = 0; Count < 4000; Count++)
        {
            if (Console.Controller.getButtonState()) // exit demo if the user presses a button
                return;
            XDirectionChange=0;
            YDirectionChange=0;
            Invader.move(Invader.getX() + x_step, Invader.getY() + y_step);
            if (Invader.getX() >= (SCREEN_WIDTH - Invader.getWidth()))
                XDirectionChange = 1;
            if (Invader.getX() == 0)
                XDirectionChange = 1;
            if (Invader.getY() > SCREEN_HEIGHT - 140)
            {
                YDirectionChange = 1;
                if (Invader.getY() < 3)
                {
                    YDirectionChange = 1;
                }
            }
            if (XDirectionChange) // Did an invader hit either edge?
                x_step = -x_step; // if so, then reverse direction
            if (YDirectionChange) // Did an invader hit either edge?
                y_step = -y_step; // if so, then reverse direction
            if (AttackerMissile.visible())
            {
                int16_t MissileTipX,MissileTipY;
                MissileTipX = AttackerMissile.getX()+AttackerMissile.getWidth() / 2;
                MissileTipY = AttackerMissile.getY()+AttackerMissile.getHeight() /2;
                for (int Index = 0; Index < LOGO_BRICK_COUNT; Index++)
                {
                    if (Logo[Index].visible())
                    {
                        if (Logo[Index].within(MissileTipX,MissileTipY))
                        {
                            Logo[Index].hide();
                            AttackerMissile.hide();
                           // Console.Sound.playTone(400,20);
                        }
                    }                                        
                }
                AttackerMissile.move(AttackerMissile.getX(),AttackerMissile.getY()+2);
                if (AttackerMissile.getY() > SCREEN_HEIGHT)
                    AttackerMissile.hide();
            }
            else
            {
                AttackerMissile.show();
                AttackerMissile.move(Invader.getX() + Invader.getWidth() / 2 - AttackerMissile.getWidth() / 2, Invader.getY() + AttackerMissile.getWidth() / 2);
            }
            k_msleep(10);
            
        }
    }
	if (demo_mode==3){
    { // Spire as a radio beacon
		for (Count = 0; Count < LOGO_BRICK_COUNT; Count++)
        {
			Logo[Count].move(Logo[Count].getX(),Logo[Count].getY()+60);
            Logo[Count].show();        
        }
		Console.Display.printX2("Address: ",9,0,SCREEN_HEIGHT - (6*FONT_HEIGHT),Console.Display.RGBToWord(0xff,0xff,0x03f),Console.Display.RGBToWord(0,0,0));		
		Console.Display.printX2(Address,10*FONT_WIDTH*2,SCREEN_HEIGHT - (6*FONT_HEIGHT),Console.Display.RGBToWord(0xff,0xff,0x03f),Console.Display.RGBToWord(0,0,0));
		DMBMessageReceived = 0;
		while(Console.Controller.getButtonState()==0)
		{
			Console.Display.putPixel(120,65,Console.Display.RGBToWord(0xff,0xff,0xff));
			Console.Display.putPixel(137,65,Console.Display.RGBToWord(0xff,0xff,0xff));
			Console.Display.putPixel(116,58,Console.Display.RGBToWord(0xff,0xff,0xff));
			Console.Display.putPixel(141,58,Console.Display.RGBToWord(0xff,0xff,0xff));
			Console.Display.putPixel(120,51,Console.Display.RGBToWord(0xff,0xff,0xff));
			Console.Display.putPixel(137,51,Console.Display.RGBToWord(0xff,0xff,0xff));
			Console.Display.putPixel(128,46,Console.Display.RGBToWord(0xff,0xff,0xff));
			Console.Display.putPixel(129,46,Console.Display.RGBToWord(0xff,0xff,0xff));
			k_msleep(100);
			Console.Display.putPixel(120,65,Console.Display.RGBToWord(0,0,0));
			Console.Display.putPixel(137,65,Console.Display.RGBToWord(0,0,0));
			Console.Display.putPixel(116,58,Console.Display.RGBToWord(0,0,0));
			Console.Display.putPixel(141,58,Console.Display.RGBToWord(0,0,0));
			Console.Display.putPixel(120,51,Console.Display.RGBToWord(0,0,0));
			Console.Display.putPixel(137,51,Console.Display.RGBToWord(0,0,0));
			Console.Display.putPixel(128,46,Console.Display.RGBToWord(0,0,0));
			Console.Display.putPixel(129,46,Console.Display.RGBToWord(0,0,0));
			k_msleep(100);
			if (DMBMessageReceived)
			messaging(DMBMessageSender);
		}
	} 

}
}
void about()
{
	uint16_t row_pos = 0;
	Console.Display.clear();
	Console.Display.printX2("For software updates",sizeof("For software updates")-1,0,row_pos,Console.Display.RGBToWord(0xff,0xff,0xff),Console.Display.RGBToWord(0,0,0));
	row_pos += 2 + (FONT_HEIGHT*2);
	Console.Display.printX2("help with code",sizeof("help with code")-1,0,row_pos,Console.Display.RGBToWord(0xff,0xff,0xff),Console.Display.RGBToWord(0,0,0));
	row_pos += 2 + (FONT_HEIGHT*2);
	Console.Display.printX2("contact:",sizeof("contact:")-1,0,row_pos,Console.Display.RGBToWord(0xff,0xff,0xff),Console.Display.RGBToWord(0,0,0));
	row_pos += 2 + (FONT_HEIGHT*2);
	Console.Display.printX2("frank@ioprog.com",sizeof("frank@ioprog.com")-1,0,row_pos,Console.Display.RGBToWord(0xff,0xff,0xf),Console.Display.RGBToWord(0,0,0));
	while(Console.Controller.getButtonState()==0)
		k_msleep(50);
	while(Console.Controller.getButtonState()!=0)
		k_msleep(50);
}
```

## src/battleship.cpp
```c
#include <zephyr/kernel.h>
#include <zephyr/sys/printk.h>
#include "mesh.h"
#include "display.h"
#include "console.h"
#include "controller.h"
#include "battleship.h"
#include "font5x7.h"
void ship::place(int len, int row, int col, int orientation)
{
    this->len = len;
    this->row = row;
    this->col = col;
    this->orientation = orientation;
    
    state = 0;
}
int ship::contains(int row, int col)
{
    // returns 1 if the ship occupies the square at this row, column
    // otherwise returns 0
    int return_value = 0;
    if (orientation == 0)
    {
        // Horizontal
        if (this->row == row) 
        {
            // same row.
            if ( (col >= this->col) && (col < (this->col+this->len)))
                return_value = 1; // it is within
        }
    }
    else
    {
        // Vertical
        if (this->col == col)
        {
            if ( (row >= this->row) && (row < (this->row+this->len)))
                return_value = 1; // it is within
        }
    }
    return return_value; // not within the bounds of this ship
}
int ship::overlaps(int len, int row, int col, int orientation)
{
    // returns 1 if the ship described by the parameters overlaps
    // this ship - uses for initial ship placement.
    // otherwise returns 0
    int return_value = 0;
    if (orientation == 0)
    {
        // Horizontal
        for (int count = 0; count < len; count++)
        {
            if (this->contains(row,col+count))
                return_value = 1;
        }
    }
    else
    {
        // Vertical
        for (int count = 0; count < len; count++)
        {
            if (this->contains(row+count,col))
                return_value = 1;
        }
    }
    return return_value;
}
/* each square can have the following properties:
 * Empty
 * Your ship (ship_id with particular bit pattern for you/them)
 * Their ship
 * Your ship hit
 * Their ship hit
 * uint8_t my_ship_map[10][10];
 */

void battleship()
{
    int row,col;
    uint8_t map[10][10];
    int ship_counter = 0;
    int Done=0;
    uint16_t target=0;
    int my_ship_hit_counter = 0;
    int their_ship_hit_counter = 0;
    int total_hits;
    total_hits = (CARRIER_COUNT*CARRIER_SQUARES) + (BATTLESHIP_COUNT*BATTLESHIP_SQUARES)+(SUBMARINE_COUNT*SUBMARINE_SQUARES)+(PATROL_BOAT_COUNT*PATROL_BOAT_SQUARES); 
	mesh_clearReplay();

    Console.Display.clear();
    Console.Display.printX2("Target node: ", 13,0,0,Console.Display.RGBToWord(0xff,0xff,0), Console.Display.RGBToWord(0,0,0) );
    while(!Done)
    {
        Console.Display.printX2(target,0,1+FONT_HEIGHT*2, Console.Display.RGBToWord(0xff,0xff,0), Console.Display.RGBToWord(0,0,0) );
        uint16_t key=0;
        while(key == 0)
        {
            key=Console.Controller.getButtonState();
            k_msleep(50);
        }
        switch(key)
        {
            case Console.Controller.Up :
            {
                target++;
                break;
            }
            case Console.Controller.Down :
            {
                target--;
                break;
            }
            case Console.Controller.A :
            {
                Done=1;
                break;
            }
            case Console.Controller.B :
            {
                Done=2;
                break;
            }
        }
        k_msleep(100);
    }

    ship Ships[CARRIER_COUNT+BATTLESHIP_COUNT+SUBMARINE_COUNT+PATROL_BOAT_COUNT];
    Console.Display.clear();
    
    for (row=0;row<10;row++)
    {
        Console.Display.drawLine(0,row*(SCREEN_HEIGHT/10),SCREEN_WIDTH,row*(SCREEN_HEIGHT/10),Console.Display.RGBToWord(0xf,0xf,0xff));
    }
    for (col=0;col<10;col++)
    {
        Console.Display.drawLine(col*(SCREEN_WIDTH/10),0,col*(SCREEN_WIDTH/10),SCREEN_HEIGHT,Console.Display.RGBToWord(0xf,0xf,0xff));
    }
    Console.Display.drawLine(0,SCREEN_HEIGHT-1,SCREEN_WIDTH-1,SCREEN_HEIGHT-1,Console.Display.RGBToWord(0xf,0xf,0xff));
    Console.Display.drawLine(SCREEN_WIDTH-1,0,SCREEN_WIDTH-1,SCREEN_HEIGHT-1,Console.Display.RGBToWord(0xf,0xf,0xff));
    for (row=0;row<10;row++)
    {
        for (col=0;col<10;col++)
            map[row][col]=0;
    }
    // start placing ships
    // Aircraft carrier first as it will be hardest to position.
    int orientation = Console.random(0,2);
    if (orientation == 0)
    {
        // Horizontal
        col=Console.random(0,CARRIER_SQUARES);
        row=Console.random(0,10);
        for (int i=0;i<CARRIER_SQUARES;i++)
            map[row][col+i]=MY_SHIP_NORMAL;
    }
    else
    {        
        col=Console.random(0,10);
        row=Console.random(0,CARRIER_SQUARES);
        for (int i=0;i<CARRIER_SQUARES;i++)
            map[row+i][col]=MY_SHIP_NORMAL;
    }
    Ships[ship_counter].place(CARRIER_SQUARES,row,col,orientation);
    ship_counter++;
    
    // Place Battleships
    int len = BATTLESHIP_SQUARES;    
    for (int ship_class_count = 0; ship_class_count < BATTLESHIP_COUNT; ship_class_count++)
    {
        Done = 0;    
        while( !Done )
        {
            // Attempt to get an empty part of the board;
            orientation = Console.random(0,2);
            if (orientation == 0)
            {
                // Horizontal
                col=Console.random(0,len);
                row=Console.random(0,10);
            }
            else
            {        
                col=Console.random(0,10);
                row=Console.random(0,len);
            }
            int invalid = 0;
            for (int ship_index=0; ship_index < ship_counter; ship_index++)
            {
                if (Ships[ship_index].overlaps(len,row,col,orientation))
                    invalid = 1;
                
            }
            if (invalid == 0)
                Done = 1;
        }
        if (orientation == 0)
        {
            for (int i=0;i<len;i++)
                map[row][col+i]=MY_SHIP_NORMAL;
        }
        else
        {
            for (int i=0;i<len;i++)
                map[row+i][col]=MY_SHIP_NORMAL;
        }
        Ships[ship_counter].place(BATTLESHIP_SQUARES,row,col,orientation);
        ship_counter++;
    }
    
    // Place submarines
    len = SUBMARINE_SQUARES;
    for (int ship_class_count = 0; ship_class_count < SUBMARINE_COUNT; ship_class_count++)
    {
        Done = 0;    
        while( !Done )
        {
            // Attempt to get an empty part of the board;
            orientation = Console.random(0,2);
            if (orientation == 0)
            {
                // Horizontal
                col=Console.random(0,len);
                row=Console.random(0,10);
            }
            else
            {        
                col=Console.random(0,10);
                row=Console.random(0,len);
            }
            int invalid = 0;
            for (int ship_index=0; ship_index < ship_counter; ship_index++)
            {
                if (Ships[ship_index].overlaps(len,row,col,orientation))
                    invalid = 1;
                
            }
            if (invalid == 0)
                Done = 1;
        }
        if (orientation == 0)
        {
            for (int i=0;i<len;i++)
                map[row][col+i]=MY_SHIP_NORMAL;
        }
        else
        {
            for (int i=0;i<len;i++)
                map[row+i][col]=MY_SHIP_NORMAL;
        }
        Ships[ship_counter].place(SUBMARINE_SQUARES,row,col,orientation);
        ship_counter++;
    }

    // Place Patrol boats
    len = PATROL_BOAT_SQUARES;    
    for (int ship_class_count = 0; ship_class_count < PATROL_BOAT_COUNT; ship_class_count++)
    {
        Done = 0;    
        while( !Done )
        {
            // Attempt to get an empty part of the board;
            orientation = Console.random(0,2);
            if (orientation == 0)
            {
                // Horizontal
                col=Console.random(0,len);
                row=Console.random(0,10);
            }
            else
            {        
                col=Console.random(0,10);
                row=Console.random(0,len);
            }
            int invalid = 0;
            for (int ship_index=0; ship_index < ship_counter; ship_index++)
            {
                if (Ships[ship_index].overlaps(len,row,col,orientation))
                    invalid = 1;
                
            }
            if (invalid == 0)
                Done = 1;
        }
        if (orientation == 0)
        {
            for (int i=0;i<len;i++)
                map[row][col+i]=MY_SHIP_NORMAL;
        }
        else
        {
            for (int i=0;i<len;i++)
                map[row+i][col]=MY_SHIP_NORMAL;
        }
        Ships[ship_counter].place(PATROL_BOAT_SQUARES,row,col,orientation);
        ship_counter++;
    }
    
    
    
    uint16_t x,y,old_row,old_col;
    x=y=old_row=old_col=0;
    Done = 0;
    while(!Done)
    {
        
        // Hide the old dot
        x = old_col * (SCREEN_WIDTH/10)+SCREEN_WIDTH/20;
        y = old_row * (SCREEN_WIDTH/10)+SCREEN_WIDTH/20;
        Console.Display.fillCircle(x,y,8,Console.Display.RGBToWord(0,0,0));
        for (int map_row=0;map_row<10;map_row++)
        {
            for (int map_col=0;map_col < 10; map_col++)
            {
                if (map[map_row][map_col]==MY_SHIP_NORMAL)
                {
                    Console.Display.fillRectangle(map_col*(SCREEN_WIDTH/10),map_row*(SCREEN_HEIGHT/10),SCREEN_WIDTH/10,SCREEN_HEIGHT/10,Console.Display.RGBToWord(0xff,0xff,0xff));
                }
                else if (map[map_row][map_col]==MY_SHIP_HIT)
                {
                    Console.Display.fillRectangle(map_col*(SCREEN_WIDTH/10),map_row*(SCREEN_HEIGHT/10),SCREEN_WIDTH/10,SCREEN_HEIGHT/10,Console.Display.RGBToWord(0xff,0xf,0xf));
                }
                else if (map[map_row][map_col]==THEIR_SHIP_NORMAL)
                {
                    Console.Display.fillRectangle(map_col*(SCREEN_WIDTH/10),map_row*(SCREEN_HEIGHT/10),SCREEN_WIDTH/10,SCREEN_HEIGHT/10,Console.Display.RGBToWord(0x0,0xff,0xff));                    
                }
                else if (map[map_row][map_col]==THEIR_SHIP_HIT)
                {
                    Console.Display.fillRectangle(map_col*(SCREEN_WIDTH/10),map_row*(SCREEN_HEIGHT/10),SCREEN_WIDTH/10,SCREEN_HEIGHT/10,Console.Display.RGBToWord(0xff,0x0,0xff));                    
                }
            }
        }        
        // show the new dot        
        x = col * (SCREEN_WIDTH/10)+SCREEN_WIDTH/20;
        y = row * (SCREEN_WIDTH/10)+SCREEN_WIDTH/20;
        Console.Display.fillCircle(x,y,8,Console.Display.RGBToWord(0x1f,0x1f,0xff));
        old_row = row;
        old_col = col;
        uint16_t key=0;
        while(key == 0)
        {/*
            key=Console.Controller.getButtonState();
            if (DMBGameMessageReceived)
            {
                // incoming message from the other player.
                uint16_t target_row, target_col, hit;
                DMBGameMessageReceived = 0;
                hit = 0;
                target_row=DMBGameMailBox.Message[0];
                target_col=DMBGameMailBox.Message[1];
                printk("Target %d, %d \n",target_row,target_col);
                for (int ship_counter = 0; ship_counter < (CARRIER_COUNT+BATTLESHIP_COUNT+SUBMARINE_COUNT+PATROL_BOAT_COUNT); ship_counter++)
                {
                    if (Ships[ship_counter].contains(target_row,target_col))  
                    {
                        hit = 1;
                        if (map[target_row][target_col] != MY_SHIP_HIT)
                        {
                            my_ship_hit_counter++;
                        }
                        if (my_ship_hit_counter >= total_hits)
                        {
                            Console.Display.clear();
                            Console.Display.printX2("You lose!",9,5,20,Console.Display.RGBToWord(0xff,0xf,0xf),Console.Display.RGBToWord(0,0,0));
							Done=1;
                        }
                        map[target_row][target_col]=MY_SHIP_HIT;
                        // Fill in the square with the MY_SHIP_HIT colour  
                        Console.Display.fillRectangle(target_col*(SCREEN_WIDTH/10),target_row*(SCREEN_HEIGHT/10),SCREEN_WIDTH/10,SCREEN_HEIGHT/10,Console.Display.RGBToWord(0xff,0xf,0xf));
                    }
                }
                dmb_message response;
                response.Message[0]=hit;
                
                sendDMBGameResponseMessage(target,&response);
            }
            k_msleep(50);
        } */
        
        switch(key)
        {
            case Console.Controller.Up :
            {
                row--;
                break;
            }
            case Console.Controller.Down :
            {
                row++;
                break;
            }
            case Console.Controller.Left :
            {
                col--;
                break;
            }
            case Console.Controller.Right :
            {
                col++;
                break;
            }
            case Console.Controller.A :
            {
                // Send a message to the opponent with row/col and wait for a reply (with timeout)
                //DMBGameMessageResponseReceived = 0;
                dmb_message msg;
                msg.Message[0]=row;
                msg.Message[1]=col;
              //  sendDMBGameMessage(target,&msg);
                // wait for a reply
                uint32_t Timeout=100;
            /*    while( (!DMBGameMessageResponseReceived) && (Timeout--))
                    k_msleep(10);
                if (DMBGameMessageResponseReceived)
                {                    
                    if (DMBGameResponseMailBox.Message[0]==1) 
                    {
                        // It's a hit 
                        if (map[row][col] != THEIR_SHIP_HIT)
                        {
                            their_ship_hit_counter++;
                        }
                        if (their_ship_hit_counter >= total_hits)
                        {
                            Console.Display.clear();
                            Console.Display.printX2("You win!",8,5,20,Console.Display.RGBToWord(0xff,0xff,0),Console.Display.RGBToWord(0,0,0));
							while(Console.Controller.getButtonState()==0)
								k_msleep(50);
							return;
							
                        }
                        map[row][col]=THEIR_SHIP_HIT;
                        Console.Display.fillRectangle(col*(SCREEN_WIDTH/10),row*(SCREEN_HEIGHT/10),SCREEN_WIDTH/10,SCREEN_HEIGHT/10,Console.Display.RGBToWord(0xff,0x0,0xff));     
                    }
                    else
                    {
                       // if (map[row][col] != 0)
                        {
                            map[row][col]=THEIR_SHIP_NORMAL;
                        }
                    }
                }
                else 
                {
                    printk("Message response timeout\n");
                }
                break; */
            }
        }
        k_msleep(50);
        if (row < 0)
            row=0;
        if (col < 0)
            col = 0;
        if (row > 9)
            row=9;
        if (col > 9)
            col=9;
       
    }
    while(Console.Controller.getButtonState()==0)
	{
		k_msleep(50);
	}
	return;
    
}
}   
```

## src/board.h
```c
/* board.h - Board-specific hooks */

/*
 * Copyright (c) 2017 Intel Corporation
 *
 * SPDX-License-Identifier: Apache-2.0
 */

#if !defined(NODE_ADDR)
#define NODE_ADDR 21
#define OTHER_NODE 22
#endif

void board_button_1_pressed(void);
uint16_t board_set_target(void);
void board_play(const char *str);

#if defined(CONFIG_BOARD_BBC_MICROBIT)
int board_init(uint16_t *addr);
void board_play_tune(const char *str);
void board_heartbeat(uint8_t hops, uint16_t feat);
void board_other_dev_pressed(uint16_t addr);
void board_attention(bool attention);
#else
static inline int board_init(uint16_t *addr)
{
	*addr = NODE_ADDR;
	return 0;
}

static inline void board_play_tune(const char *str)
{
}

void board_heartbeat(uint8_t hops, uint16_t feat)
{
}

void board_other_dev_pressed(uint16_t addr)
{
}

void board_attention(bool attention)
{
}
#endif
```

## src/console.cpp
```c
#include <zephyr/random/random.h>
#include "console.h"
#include "font5x7.h"
console Console;
int console::begin()
{    
    Display.begin();    
    Controller.begin();
    Sound.begin();
    random_seed();
    return 0;
}

uint32_t console::random(uint32_t lower,uint32_t upper)
{
    return (prbs()%(upper-lower))+lower;
}
uint32_t console::prbs()
{
	// This is an unverified 31 bit PRBS generator
	// It should be maximum length but this has not been verified 
	unsigned long new_bit=0;
	static int busy=0; // need to prevent re-entrancy here
	if (!busy)
	{
		busy=1;
		new_bit= ((shift_register & (1<<27))>>27) ^ ((shift_register & (1<<30))>>30);
		new_bit= ~new_bit;
		new_bit = new_bit & 1;
		shift_register=shift_register << 1;
		shift_register=shift_register | (new_bit);
		busy=0;
	}
	return shift_register & 0x7fffffff; // return 31 LSB's 
}
void console::random_seed()
{
    // Need to find a source of random data.  This layer of BBG is meant to be 
    // hardware independent so I don't want to break that.  Will have to obtain 
    // a random seed from one of the lower layers of the BBG stack without introducing
    // additional complexity.  Hardware aware object choices: Controller, Display, Timer, Sound
    // An analogue input would be nice so this probably rules out the Display and Timer objects
    // leaving Sound and Controller.  Some variations of BBG may use an analogue joystick so 
    // perhaps a call to readAnalogue(chan_num) might be a good choice?  The channel number
    // can be defined in the controller class (as a static) and mapped appropriately within the
    // Controller object.  Will add up and scale a few reads to change more bits in the shift register
    shift_register = 0;
    while(shift_register ==0)
    {
        shift_register = sys_rand32_get();
    }
	return;
    while(shift_register == 0)
    {
        for (int i=1;i<17;i++)
            shift_register += Controller.readTemperature()<<i;
    }   
    Controller.stopADC();
}
void console::sleep(uint32_t ms)
{
	k_msleep(ms);
}
```

## src/controller.cpp
```c
#include <stdint.h>
#include <zephyr/kernel.h>
#include <zephyr/sys/printk.h>
#include <zephyr/device.h>
#include <zephyr/drivers/gpio.h>

#include "controller.h" 
// Button configuration
#define UP_PORT_BIT 28
#define DOWN_PORT_BIT 03
#define LEFT_PORT_BIT 25 
#define RIGHT_PORT_BIT 5 
#define A_PORT_BIT 1
#define B_PORT_BIT 30
static const struct device *gpio0,*gpio1;

int controller::begin()
{
	gpio0=device_get_binding("GPIO_0");
	gpio1=device_get_binding("GPIO_1");
	if (gpio0 == NULL)
	{
		printk("Error acquiring GPIO 0 interface\n");
		return -1;
	}
	if (gpio1 == NULL)
	{
		printk("Error acquiring GPIO 1 interface\n");
		return -2;
	}
	gpio_pin_configure(gpio0, UP_PORT_BIT, GPIO_INPUT | GPIO_PULL_UP);
	gpio_pin_configure(gpio0, DOWN_PORT_BIT, GPIO_INPUT | GPIO_PULL_UP);
	gpio_pin_configure(gpio0, LEFT_PORT_BIT, GPIO_INPUT | GPIO_PULL_UP);
	gpio_pin_configure(gpio1, RIGHT_PORT_BIT, GPIO_INPUT | GPIO_PULL_UP);
	gpio_pin_configure(gpio0, A_PORT_BIT, GPIO_INPUT | GPIO_PULL_UP);
	gpio_pin_configure(gpio0, B_PORT_BIT, GPIO_INPUT | GPIO_PULL_UP);
	return 0;
}

void controller::stopADC()
{
}
uint16_t controller::getButtonState()
{
    uint16_t ReturnValue = 0;
	uint32_t port_state0 = 0;
	uint32_t port_state1 = 0;
	ReturnValue = gpio_port_get_raw(gpio0,&port_state0);
	ReturnValue = gpio_port_get_raw(gpio1,&port_state1);		
	if ((port_state0 & (1 << UP_PORT_BIT))==0)
		ReturnValue |= Up;
	if ((port_state0 & (1 << DOWN_PORT_BIT))==0)
		ReturnValue |= Down;
	if ((port_state0 & (1 << LEFT_PORT_BIT))==0)
		ReturnValue |= Left;
	if ((port_state1 & (1 << RIGHT_PORT_BIT))==0)
			ReturnValue |= Right;
	if ((port_state0 & (1 << A_PORT_BIT))==0)
			ReturnValue |= A;
	if ((port_state0 & (1 << B_PORT_BIT))==0)	
			ReturnValue |= B;		
	
    return ReturnValue;
}
uint16_t controller::readTemperature()
{
	return 0;
}
```

## src/dmb_message_type.h
```c
#ifndef __DMB_MESSAGE_TYPE_H
#define __DMB_MESSAGE_TYPE_H
#define MAX_MESSAGE_LEN 8
typedef struct {
    uint8_t Message[MAX_MESSAGE_LEN];
} dmb_message;

/* extern volatile uint32_t DMBMessageReceived;
extern volatile dmb_message DMBMailBox;
extern volatile uint16_t DMBMessageSender;
extern volatile uint32_t DMBGameMessageReceived;
extern volatile dmb_message DMBGameMailBox;
//extern volatile uint32_t DMBGameMessageResponseReceived;
//extern volatile dmb_message DMBGameResponseMailBox; */
#endif
```

## src/mesh.h
```c
#ifndef __mesh_h
#define __mesh_h
#include "dmb_message_type.h"
#define MAX_NAME_LEN MAX_MESSAGE_LEN

#ifdef __cplusplus
extern "C" {    
#endif

void mesh_begin(uint16_t addr);
void sendDMBMessage(uint16_t target, dmb_message * dmbmsg);
void sendDMBGameMessage(uint16_t the_target, dmb_message * dmbmsg);
void sendDMBGameResponseMessage(uint16_t the_target, dmb_message * dmbmsg); 
void mesh_clearReplay();
void mesh_suspend();
void mesh_resume();

#ifdef __cplusplus
}
#endif 

extern volatile uint32_t DMBMessageReceived;
extern volatile dmb_message DMBMailBox;
extern volatile uint32_t DMBGameMessageReceived;
extern volatile dmb_message DMBGameMailBox;
extern volatile uint32_t DMBGameMessageResponseReceived;
extern volatile dmb_message DMBGameResponseMailBox;

#endif
```

## src/messaging.cpp
```c
#include "console.h"
extern "C" {
#include "mesh.h"
}
#include "mesh.h"
#include "osk.h"
#include "font5x7.h"
extern "C" void send_vendor_message(uint16_t addr, const char *message);


class ScrollingTextBox {
#define MAX_LINES 6	
public:
	ScrollingTextBox() {
		CursorRow = 0;
	}
	void clear()
	{
		CursorRow = 0;
	}
	void appendLine(char *Line);	
	void show();
private:
uint32_t CursorRow;
char Buffer[MAX_LINES][MAX_MESSAGE_LEN];
};

void ScrollingTextBox::appendLine(char *Line)
{
	if (CursorRow < MAX_LINES)
	{
		for (uint32_t c=0;c<MAX_MESSAGE_LEN;c++)
		{
			Buffer[CursorRow][c]=Line[c];
		}	
		CursorRow++;
	}
	else
	{
		// scroll the other lines 
		for (uint32_t r=1;r<MAX_LINES;r++)
		{
			for (uint32_t c=0;c<MAX_MESSAGE_LEN;c++)
			{
				Buffer[r-1][c]=Buffer[r][c];
			}
		}
		for (int c=0;c<MAX_MESSAGE_LEN;c++)
		{
			Buffer[MAX_LINES-1][c]=Line[c];
		}
	
	}
}
void ScrollingTextBox::show()
{
	Console.Display.fillRectangle(0,0,SCREEN_WIDTH,6*FONT_HEIGHT*2,Console.Display.RGBToWord(0,0,0));
	for (uint32_t r=0;r<CursorRow;r++)
	{
		int len=0;
		while(len < MAX_MESSAGE_LEN)
		{
			if (Buffer[r][len]==0)
				break;
			len++;
		}
		Console.Display.printX2((char *)&Buffer[r][0],len,0,r*(2*FONT_HEIGHT+3),Console.Display.RGBToWord(0xff,0xff,0), Console.Display.RGBToWord(0,0,0));
	}
}
ScrollingTextBox tb;
void ShowIncomingMessages(void)
{
	if (DMBMessageReceived)
	{
		int len=0;
		while(len < MAX_MESSAGE_LEN)
		{
			if (DMBMailBox.Message[len]==0)
				break;
			len++;
		}
		tb.appendLine((char *)DMBMailBox.Message);
		tb.show();
		
		DMBMessageReceived=0;
	} 
}

void messaging(int other_address)
{
	osk OSK;
    uint16_t target=0;
    int Done=0;	
	mesh_clearReplay();
    Console.Display.clear();
	// Choose target node
	if (other_address == 0)
	{
		Console.Display.printX2("Target node: ", 13,0,0,Console.Display.RGBToWord(0xff,0xff,0), Console.Display.RGBToWord(0,0,0) );
		while(!Done)
		{
			Console.Display.printX2(target,0,1+FONT_HEIGHT*2, Console.Display.RGBToWord(0xff,0xff,0), Console.Display.RGBToWord(0,0,0) );
			uint16_t key=0;
			while(key == 0)
			{
				key=Console.Controller.getButtonState();
				k_msleep(50);
			}
			switch(key)
			{
				case Console.Controller.Up :
				{
					target++;
					break;
				}
				case Console.Controller.Down :
				{
					target--;
					break;
				}
				case Console.Controller.A :
				{
					Done=1;
					break;
				}
				case Console.Controller.B :
				{
					Done=2;
					break;
				}
			}
			k_msleep(100);		
		}
	}
	else
	{
		target = other_address;
		Done=1;
	}
	if (Done==1) 
	{
		Done = 0;	
		while(!Done){
			Console.Display.clear();
			Console.Display.printX2("Target node: ", 13,0,0,Console.Display.RGBToWord(0xff,0xff,0), Console.Display.RGBToWord(0,0,0) );
			Console.Display.printX2(target,0,(FONT_HEIGHT*2)+1,Console.Display.RGBToWord(0xff,0xff,0), Console.Display.RGBToWord(0,0,0) );
			Done = 0;
			while (Done == 0)
			{
				// Enter messaging phase			
				OSK.show(&Console.Display, &Console.Controller);
				char word[MAX_MESSAGE_LEN];
				for (int w=0;w<MAX_MESSAGE_LEN;w++)
					word[w]=0;
				while (OSK.getUserInput(word,ShowIncomingMessages)>0)
				{
					dmb_message msg;
					for (int i=0;i<MAX_MESSAGE_LEN;i++)
					{
						msg.Message[i]=word[i];
						word[i]=0;
					}				
					sendDMBMessage(target, &msg);
					
				}
				Done=1;
			}
		}
	}
}
```

## src/realm.h
```c
// realm.h
// Some game constants
#include <stdint.h>
#define MAP_WIDTH 14
#define MAP_HEIGHT 10
#define MAX_NAME_LEN 20
#define MAX_WEAPONS 4


typedef unsigned char byte;
typedef struct {
	// The MSB of each entry specifies whether the contents of this
	// square are visible or not.
	uint8_t map[MAP_HEIGHT][MAP_WIDTH];
	
} tRealm;
typedef struct {
	char name[MAX_NAME_LEN+1];
	byte health;	
	byte strength;
	byte magic;
	byte wealth;
	byte x,y;
	byte Weapon1;
	byte Weapon2;
} tPlayer;

// Function prototypes
unsigned prbs();
unsigned random(unsigned range);
void showHelp();
void showGameMessage(const char *Msg);
char getUserInput();
void microrealms(void);
void initRealm(tRealm *Realm);
void showRealm(tRealm *Realm,tPlayer *thePlayer);
void initPlayer(tPlayer *Player,tRealm *Realm);
void showPlayer(tPlayer *thePlayer);
int step(char Direction,tPlayer *Player,tRealm *Realm);
void setHealth(tPlayer *Player,int health);
void setStrength(tPlayer *Player, byte strength);
int addWeapon(tPlayer *Player, int Weapon);
int doChallenge(tPlayer *Player, int BadGuyIndex);
const char *getWeaponName(int index);
void zap(void);
```

## src/sound.cpp
```c
#include "sound.h"
#include <stdint.h>

#define PWM_PIN 0
static sound *pSound;
static const struct device *pwm;

int sound::begin()
{
	
	pSound = this;
	pwm = device_get_binding("PWM_0");
	if (pwm == NULL)
	{
		printk("Error acquiring PWM\r\n");
		return -1;
		
	}
	stopTone();
	k_timer_init(&sound_timer, sound_timer_handler, NULL);
	k_timer_start(&sound_timer, K_MSEC(1), K_MSEC(1));
	return 0;
}
void sound::playTone(uint16_t Frequency, uint16_t ms)
{
	int ret;
	if (Frequency == 0)
		return;
	uint32_t Period = (uint32_t)BASE_PWM_CLOCK / (uint32_t)Frequency; 	
	ret = pwm_set_cycles(pwm, PWM_PIN, Period,Period/2,0);
    pSound->tone_time = ms;    
}
void sound::stopTone()
{
	pwm_set_cycles(pwm, PWM_PIN, BASE_PWM_CLOCK / 1000,0,0);	
}

int  sound::SoundPlaying()
{
	
    if (tone_time > 0)
        return 1;
    else        
        return 0;
}
void sound::playMelody(const uint16_t *Tones,const uint16_t *Times,int Len)
{
	// NOTE: The Tones and Times arrays must continue to exist in their original
	// context for the duration of the melody.  They are not copied to a local buffer
	this->melody_tones = Tones;
	this->melody_times = Times;
	this->melody_length=Len;
    tone_callback();
}
void sound::tone_callback()
{
	pSound->stopTone();
	// Should check to see if there are more notes to play
	if (melody_length)
	{
		playTone(*melody_tones, *melody_times);
		melody_tones++;
		melody_times++;
		melody_length--;
	}
}

void sound_expiry_handler(struct k_work *work)
{
	// If this note is done then notify the rest of the sound object
	if (pSound->tone_time)
    {
        pSound->tone_time--;
        if (pSound->tone_time == 0)
        {
            pSound->tone_callback();
        }
    }
	
}
K_WORK_DEFINE(my_sound_timer,sound_expiry_handler);

void sound_timer_handler(struct k_timer *timer_id)
{
	// This is in interrupt context so have to schedule work to be done in process context
	k_work_submit(&my_sound_timer);
}
```
